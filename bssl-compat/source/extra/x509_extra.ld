PROVIDE(X509_cmp = ossl_X509_cmp);
PROVIDE(X509_free = ossl_X509_free);
PROVIDE(X509_get_subject_name = ossl_X509_get_subject_name);
PROVIDE(X509_NAME_oneline = ossl_X509_NAME_oneline);
PROVIDE(X509_get_issuer_name = ossl_X509_get_issuer_name);
PROVIDE(X509_VERIFY_PARAM_set_flags = ossl_X509_VERIFY_PARAM_set_flags);
PROVIDE(X509_VERIFY_PARAM_new = ossl_X509_VERIFY_PARAM_new);
PROVIDE(X509_VERIFY_PARAM_free = ossl_X509_VERIFY_PARAM_free);
