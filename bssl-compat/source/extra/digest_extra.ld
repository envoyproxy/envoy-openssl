PROVIDE(EVP_MD_size = ossl_EVP_MD_get_size);
PROVIDE(EVP_MD_CTX_copy_ex = ossl_EVP_MD_CTX_copy_ex);
PROVIDE(EVP_get_digestbyname = ossl_EVP_get_digestbyname);
PROVIDE(EVP_md4 = ossl_EVP_md4);
PROVIDE(EVP_md5 = ossl_EVP_md5);
PROVIDE(EVP_md5_sha1 = ossl_EVP_md5_sha1);
PROVIDE(EVP_MD_CTX_move = ossl_EVP_MD_CTX_copy_ex);
PROVIDE(EVP_sha512_256 = ossl_EVP_sha512_256);
PROVIDE(OBJ_nid2obj = ossl_OBJ_nid2obj);
PROVIDE(OBJ_txt2obj = ossl_OBJ_txt2obj);
PROVIDE(SHA1 = ossl_SHA1);
PROVIDE(SHA224 = ossl_SHA224);
PROVIDE(SHA256 = ossl_SHA256);
PROVIDE(SHA256_Init = ossl_SHA256_Init);
PROVIDE(SHA256_Update = ossl_SHA256_Update);
PROVIDE(SHA384 = ossl_SHA384);
PROVIDE(SHA512 = ossl_SHA512);
