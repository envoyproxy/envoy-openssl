PROVIDE(SSL_accept = ossl_SSL_accept);
PROVIDE(SSL_connect = ossl_SSL_connect);
PROVIDE(SSL_CIPHER_description = ossl_SSL_CIPHER_description);
PROVIDE(SSL_CIPHER_get_version = ossl_SSL_CIPHER_get_version);
PROVIDE(SSL_CIPHER_standard_name = ossl_SSL_CIPHER_standard_name);
PROVIDE(SSL_CTX_free = ossl_SSL_CTX_free);
PROVIDE(SSL_CTX_get_ex_data = ossl_SSL_CTX_get_ex_data);
PROVIDE(SSL_CTX_new = ossl_SSL_CTX_new);
PROVIDE(SSL_CTX_set_ex_data = ossl_SSL_CTX_set_ex_data);
PROVIDE(SSL_CTX_use_certificate_file = ossl_SSL_CTX_use_certificate_file);
PROVIDE(SSL_CTX_use_PrivateKey_file = ossl_SSL_CTX_use_PrivateKey_file);
PROVIDE(SSL_CTX_load_verify_locations = ossl_SSL_CTX_load_verify_locations);
PROVIDE(SSL_free = ossl_SSL_free);
PROVIDE(SSL_get_ciphers = ossl_SSL_get_ciphers);
PROVIDE(SSL_set_fd = ossl_SSL_set_fd);
PROVIDE(SSL_SESSION_set_protocol_version = ossl_SSL_SESSION_set_protocol_version);
PROVIDE(SSL_is_server = ossl_SSL_is_server);
PROVIDE(SSL_CTX_use_certificate_chain_file = ossl_SSL_CTX_use_certificate_chain_file);
PROVIDE(SSL_CTX_add_client_CA = ossl_SSL_CTX_add_client_CA);
PROVIDE(SSL_load_client_CA_file = ossl_SSL_load_client_CA_file);
PROVIDE(SSL_CTX_set1_param = ossl_SSL_CTX_set1_param);
PROVIDE(SSL_CTX_get_verify_mode = ossl_SSL_CTX_get_verify_mode);
PROVIDE(SSL_add_file_cert_subjects_to_stack = ossl_SSL_add_file_cert_subjects_to_stack);